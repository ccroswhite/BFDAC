`timescale 1ns / 1ps  // force recompile

// =============================================================================
// HALFBAND_X2 — Parameterized Half-Band ×2 Interpolating FIR
//
// Performs 2× interpolation using a symmetric linear-phase half-band FIR.
// Half-band property: every other coefficient is zero (except center tap),
// so only ceil(NUM_TAPS/4) multiplications are needed.
//
// Architecture:
//   - Symmetric folding: h[n] = h[N-1-n], so each DSP48 handles two taps
//   - Zero-coefficient skipping: even-indexed taps (except center) are zero
//   - Two output phases per input sample (polyphase decomposition):
//       Phase 0 (even): center tap contribution + non-zero symmetric pairs
//       Phase 1 (odd):  input sample passed through directly (gain=1 half-band)
//   - Pipelined DSP48E2 inference (3-stage: pre-add → multiply → post-add)
//
// Latency: GROUP_DELAY = (NUM_TAPS-1)/2 + DSP_PIPE_STAGES input sample clocks
//          (propagated as output port for downstream alignment).
//
// Coefficient format: signed 18-bit fixed-point, Q1.17
//   (range -1.0 to +0.99999, scaled so sum of non-zero coefs ≈ 0.5 for unity gain)
//
// Instantiation example (three stages in dac_dsp_core):
//   halfband_x2 #(.NUM_TAPS(63), .DATA_WIDTH(24), .COEF_WIDTH(18), .ACC_WIDTH(48))
//       u_hb1 (.clk(dsp_clk), .rst_n(sys_rst_n), .in_valid(fir_valid),
//              .data_in(fir_out), .out_valid(hb1_valid), .data_out(hb1_out));
//
// Supported NUM_TAPS: any odd value ≥ 3.
//   HB1 post polyphase FIR: 63 taps (31 non-zero pairs + center)
//   HB2: 31 taps
//   HB3: 15 taps
//
// Resource usage per instance (approximate, 63-tap stereo):
//   DSP48E2: ~16 (32 symmetric pairs, but half-band zeros reduce to 16 active)
//   RAMB36:  0 (all shift registers inferred as SRL16/32 in LUTs or FFs)
// =============================================================================
module halfband_x2 #(
    parameter int NUM_TAPS   = 63,    // Must be odd. Half-band: coef[(NUM_TAPS-1)/2] is center.
    parameter int DATA_WIDTH = 24,
    parameter int COEF_WIDTH = 18,
    parameter int ACC_WIDTH  = 48,
    // Round 30 fix: TRUE x2 interpolation — each input sample produces TWO
    // outputs (passthru center sample, then the filtered midpoint
    // OUT_SPACING clocks later). Input spacing must exceed OUT_SPACING+1.
    // dac_dsp_core uses 4/2/1 for HB1/HB2/HB3 (FIR pacing = 64 clk).
    parameter int OUT_SPACING = 1
)(
    input  logic                         clk,
    input  logic                         rst_n,

    // Input: one sample per input_rate clock (valid strobe)
    input  logic                         in_valid,
    input  logic signed [DATA_WIDTH-1:0] data_in,

    // Output: two samples per input sample (interleaved, valid strobe)
    output logic                         out_valid,
    output logic signed [ACC_WIDTH-1:0]  data_out
);

    // -------------------------------------------------------------------------
    // Parameters
    // -------------------------------------------------------------------------
    localparam int CENTER_TAP  = (NUM_TAPS - 1) / 2;   // Index of center tap
    localparam int NUM_NONZERO = (NUM_TAPS + 1) / 4;    // Non-zero coef pairs each side
    // DSP pipeline depth: pre-add(1) + multiply(1) + accumulate(1) = 3 stages
    localparam int DSP_STAGES  = 3;

    // -------------------------------------------------------------------------
    // Half-band FIR coefficient ROM
    // Only the non-zero odd-indexed taps are stored (symmetric, one side).
    // Index k → coefficient h[CENTER_TAP - (2k+1)] = h[CENTER_TAP + (2k+1)]
    // for k = 0, 1, ..., NUM_NONZERO-1.
    // Center tap stored separately.
    //
    // Default coefficients: Kaiser-windowed half-band, 63 taps, -100 dB stopband.
    // For NUM_TAPS != 63, override COEF_INIT or use a parameter array.
    // These are Q1.17 (multiply by 2^17 = 131072 to get integer representation).
    //
    // NOTE: For production use, replace with coefficients generated by your
    // preferred filter design tool (e.g., MATLAB firhalfband, Python scipy.signal).
    // The values below are representative for simulation and initial synthesis.
    // -------------------------------------------------------------------------

    // Coefficient storage — ROM inferred from initial block
    // Indexed [0..NUM_NONZERO-1]: h[CENTER_TAP-1], h[CENTER_TAP-3], ...
    logic signed [COEF_WIDTH-1:0] coef_rom [0:NUM_NONZERO-1];
    logic signed [COEF_WIDTH-1:0] coef_center;

    // -------------------------------------------------------------------------
    // Default coefficient initialisation (63-tap Kaiser half-band, -100dB)
    // For other tap counts the user must override via $readmemh or parameter.
    // -------------------------------------------------------------------------
    initial begin
        for (int i = 0; i < NUM_NONZERO; i++) coef_rom[i] = '0;
        // coef_center = h[CENTER_TAP] = 0.5 exactly → Q1.17: 0.5 * 131072 = 65536 = 0x10000
        coef_center = 18'sh10000;
        if (NUM_TAPS == 63) begin
            // 63-tap Kaiser half-band FIR, beta=16.0 (gen_hb_coefs2.py, Step 4C.4)
            // QUANTIZED-response verified: image-band (748-768 kHz) rejection
            // 127.3 dB, passband droop at 20 kHz 0.000004 dB, DC gain exact.
            // coef_rom[k] = h[31-(2k+1)] for k=0..15, Q1.17.
            coef_rom[ 0] = 18'sh0A1AA;  // h[30]: +41386  (+0.31575)
            coef_rom[ 1] = 18'sh3CD7C;  // h[28]: -12932  (-0.09866)
            coef_rom[ 2] = 18'sh01A9D;  // h[26]:  +6813  (+0.05198)
            coef_rom[ 3] = 18'sh3F065;  // h[24]:  -3995  (-0.03048)
            coef_rom[ 4] = 18'sh0094C;  // h[22]:  +2380  (+0.01816)
            coef_rom[ 5] = 18'sh3FA96;  // h[20]:  -1386  (-0.01057)
            coef_rom[ 6] = 18'sh00303;  // h[18]:   +771  (+0.00588)
            coef_rom[ 7] = 18'sh3FE6C;  // h[16]:   -404  (-0.00308)
            coef_rom[ 8] = 18'sh000C4;  // h[14]:   +196  (+0.00150)
            coef_rom[ 9] = 18'sh3FFAA;  // h[12]:    -86  (-0.00066)
            coef_rom[10] = 18'sh00022;  // h[10]:    +34  (+0.00026)
            coef_rom[11] = 18'sh3FFF5;  // h[ 8]:    -11  (-0.00008)
            coef_rom[12] = 18'sh00003;  // h[ 6]:     +3  (+0.00002)
            coef_rom[13] = 18'sh3FFFF;  // h[ 4]:     -1  (-0.00001)
            coef_rom[14] = 18'sh00000;  // h[ 2]:      0
            coef_rom[15] = 18'sh00000;  // h[ 0]:      0
        end else if (NUM_TAPS == 31) begin
            // 31-tap Kaiser half-band FIR, beta=13.5 (gen_hb_coefs2.py, Step 4C.4)
            // QUANTIZED-response verified: image-band (1.516-1.536 MHz) rejection
            // 140.4 dB, passband droop 0.000001 dB, DC gain exact.
            // coef_rom[k] = h[15-(2k+1)] for k=0..7, Q1.17.
            coef_rom[ 0] = 18'sh09E55;  // h[14]: +40533  (+0.30924)
            coef_rom[ 1] = 18'sh3D636;  // h[12]: -10698  (-0.08162)
            coef_rom[ 2] = 18'sh00F85;  // h[10]:  +3973  (+0.03031)
            coef_rom[ 3] = 18'sh3FACB;  // h[ 8]:  -1333  (-0.01017)
            coef_rom[ 4] = 18'sh0015D;  // h[ 6]:   +349  (+0.00266)
            coef_rom[ 5] = 18'sh3FFC3;  // h[ 4]:    -61  (-0.00047)
            coef_rom[ 6] = 18'sh00005;  // h[ 2]:     +5  (+0.00004)
            coef_rom[ 7] = 18'sh00000;  // h[ 0]:      0
        end else if (NUM_TAPS == 15) begin
            // 15-tap Kaiser half-band FIR, beta=10.25 (gen_hb_coefs2.py, Step 4C.4)
            // QUANTIZED-response verified: image-band (3.052-3.072 MHz) rejection
            // 124.4 dB, passband droop 0.000005 dB, DC gain exact.
            // coef_rom[k] = h[7-(2k+1)] for k=0..3, Q1.17.
            coef_rom[ 0] = 18'sh0937D;  // h[ 6]: +37757  (+0.28806)
            coef_rom[ 1] = 18'sh3EAB6;  // h[ 4]:  -5450  (-0.04158)
            coef_rom[ 2] = 18'sh001CF;  // h[ 2]:   +463  (+0.00353)
            coef_rom[ 3] = 18'sh3FFFE;  // h[ 0]:     -2  (-0.00002)
        end
    end

    // -------------------------------------------------------------------------
    // Input sample shift register (depth = NUM_TAPS)
    // Only populated on in_valid; advances one position per in_valid.
    // -------------------------------------------------------------------------
    logic signed [DATA_WIDTH-1:0] shreg [0:NUM_TAPS-1];

    always_ff @(posedge clk) begin
        if (!rst_n) begin
            for (int i = 0; i < NUM_TAPS; i++) shreg[i] <= '0;
        end else if (in_valid) begin
            shreg[0] <= data_in;
            for (int i = 1; i < NUM_TAPS; i++) shreg[i] <= shreg[i-1];
        end
    end

    // -------------------------------------------------------------------------
    // Valid pipeline — packed vectors avoid XSim unpacked-array elaboration bugs
    // (Round 30: the per-input phase toggle is GONE — it silently produced one
    // output per input, i.e. NO rate increase. Both phases are now emitted per
    // input; see output stage.)
    // -------------------------------------------------------------------------
    logic [DSP_STAGES:0] valid_pipe;

    always_ff @(posedge clk) begin
        if (!rst_n) begin
            valid_pipe <= '0;
        end else begin
            valid_pipe <= {valid_pipe[DSP_STAGES-1:0], in_valid};
        end
    end

    // -------------------------------------------------------------------------
    // MAC accumulator — pipelined over DSP_STAGES
    // Symmetric folding: for each non-zero tap pair k, pre-add the two
    // symmetric samples then multiply by the coefficient.
    // -------------------------------------------------------------------------

    // Stage 0: pre-add symmetric pairs (plain always_ff — no generate/localparam)
    logic signed [DATA_WIDTH:0] pre_add [0:NUM_NONZERO-1];

    always_ff @(posedge clk) begin
        if (!rst_n) begin
            for (int k = 0; k < NUM_NONZERO; k++)
                pre_add[k] <= '0;
        end else if (in_valid) begin
            for (int k = 0; k < NUM_NONZERO; k++)
                pre_add[k] <= $signed({shreg[CENTER_TAP-(2*k+1)][DATA_WIDTH-1],
                                       shreg[CENTER_TAP-(2*k+1)]}) +
                              $signed({shreg[CENTER_TAP+(2*k+1)][DATA_WIDTH-1],
                                       shreg[CENTER_TAP+(2*k+1)]});
        end
    end

    // Stage 1: multiply each pre-add by coefficient
    logic signed [DATA_WIDTH+COEF_WIDTH:0] products [0:NUM_NONZERO-1];

    always_ff @(posedge clk) begin
        if (!rst_n) begin
            for (int k = 0; k < NUM_NONZERO; k++)
                products[k] <= '0;
        end else if (valid_pipe[0]) begin
            for (int k = 0; k < NUM_NONZERO; k++)
                products[k] <= pre_add[k] * $signed(coef_rom[k]);
        end
    end

    // Center tap contribution (no pre-add, direct multiply)
    logic signed [DATA_WIDTH:0]            center_sample_s1;
    logic signed [DATA_WIDTH+COEF_WIDTH:0] center_product;

    always_ff @(posedge clk) begin
        if (!rst_n) begin
            center_sample_s1 <= '0;
            center_product   <= '0;
        end else begin
            if (in_valid)
                center_sample_s1 <= $signed({shreg[CENTER_TAP][DATA_WIDTH-1], shreg[CENTER_TAP]});
            if (valid_pipe[0])
                center_product   <= center_sample_s1 * $signed(coef_center);
        end
    end

    // Stage 2: accumulate all products (adder tree inferred)
    logic signed [ACC_WIDTH-1:0] acc_filtered;
    logic signed [ACC_WIDTH-1:0] acc_passthru;
    logic signed [ACC_WIDTH-1:0] acc_sum_comb;  // combinatorial sum wire

    always_comb begin
        acc_sum_comb = ACC_WIDTH'(center_product >>> COEF_WIDTH);
        for (int j = 0; j < NUM_NONZERO; j++)
            acc_sum_comb = acc_sum_comb + ACC_WIDTH'(products[j] >>> COEF_WIDTH);
    end

    always_ff @(posedge clk) begin
        if (!rst_n) begin
            acc_filtered <= '0;
            acc_passthru <= '0;
        end else if (valid_pipe[2]) begin
            acc_filtered <= acc_sum_comb;
            acc_passthru <= ACC_WIDTH'(signed'(shreg[CENTER_TAP]) <<< (ACC_WIDTH - DATA_WIDTH));
        end
    end

    // -------------------------------------------------------------------------
    // Output stage (Round 30 fix): TWO outputs per input sample.
    //   1) pass-through of the center-aligned sample (even output phase)
    //   2) the half-band filtered midpoint, OUT_SPACING clocks later (odd phase)
    // Output sequence: x[n-C], mid(x[n-C],x[n-C+1]), x[n-C+1], ... = true x2.
    // -------------------------------------------------------------------------
    logic                        filt_pending;
    logic [3:0]                  filt_cnt;
    logic signed [ACC_WIDTH-1:0] filt_hold;

    always_ff @(posedge clk) begin
        if (!rst_n) begin
            out_valid    <= 1'b0;
            data_out     <= '0;
            filt_pending <= 1'b0;
            filt_cnt     <= '0;
            filt_hold    <= '0;
        end else begin
            out_valid <= 1'b0;
            if (valid_pipe[DSP_STAGES]) begin
                // synthesis translate_off
                if (filt_pending)
                    $error("halfband_x2: input spacing too small, filtered output lost");
                // synthesis translate_on
                out_valid    <= 1'b1;
                data_out     <= acc_passthru;
                filt_hold    <= acc_filtered;
                filt_pending <= 1'b1;
                filt_cnt     <= 4'(OUT_SPACING - 1);
            end else if (filt_pending) begin
                if (filt_cnt == 0) begin
                    out_valid    <= 1'b1;
                    data_out     <= filt_hold;
                    filt_pending <= 1'b0;
                end else
                    filt_cnt <= filt_cnt - 1'b1;
            end
        end
    end

endmodule
