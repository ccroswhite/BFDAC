`timescale 1ns / 1ps

module noise_shaper_2nd_order #(
    parameter int INPUT_WIDTH = 32, // High-precision input
    parameter int FRAC_WIDTH  = 26  // Bits discarded during truncation
)(
    input  logic                   clk,
    input  logic                   rst_n,
    input  logic                   enable,  // Pulled high when FIR outputs a valid sample

    // High-precision signed audio from the FIR Interpolator.
    // Assumes scaled so the top 6 bits represent -16 to +15.
    input  logic signed [INPUT_WIDTH-1:0] data_in, 
    
    // Unsigned 0 to 32 physical drive for the DEM Mapper
    output logic [5:0]                    dem_drive_out 
);

    // =================================---------------------------------------
    // Fixed Point Architecture
    // Top 6 bits = Integer (Physical Resistors)
    // Bottom 26 bits = Fraction (Quantization Error)
    // =================================---------------------------------------

    // 1. Shift AC audio to DC Offset (so -16 becomes 0, and +15 becomes 31)
    logic signed [INPUT_WIDTH:0] offset_audio;
    assign offset_audio = $signed(data_in) + $signed({7'd16, {FRAC_WIDTH{1'b0}}});

    // 2. The Error Registers (e[n-1] and e[n-2])
    // Must be signed to handle negative error injection
    logic signed [FRAC_WIDTH+2:0] error_z1; 
    logic signed [FRAC_WIDTH+2:0] error_z2;

    // 3. The Modulator Summation Node
    logic signed [INPUT_WIDTH+3:0] quantizer_in;
    logic signed [INPUT_WIDTH+3:0] noise_shaped_audio;

    always_comb begin
        // The 2nd Order Error Feedback Formula:
        // y[n] = x[n] + 2*e[n-1] - e[n-2]
        
        // Note: (error_z1 <<< 1) is a free hardware multiply by 2
        noise_shaped_audio = offset_audio + (error_z1 <<< 1) - error_z2;
    end

    // 4. The Quantizer & Feedback Loop
    always_ff @(posedge clk or negedge rst_n) begin
        if (!rst_n) begin
            error_z1      <= '0;
            error_z2      <= '0;
            dem_drive_out <= 6'd16; // Default to physical zero (center)
        end else if (enable) begin
            
            // A. Hard Limiting (Protecting the physical Array bounds 0 to 32)
            // If the noise shaping pushes the integer above 32 or below 0, clamp it.
            if (noise_shaped_audio[INPUT_WIDTH+3 : FRAC_WIDTH] > 32) begin
                dem_drive_out <= 6'd32;
                // Calculate actual error generated by the clamp
                error_z1 <= noise_shaped_audio - {7'd32, {FRAC_WIDTH{1'b0}}};
            end 
            else if (noise_shaped_audio[INPUT_WIDTH+3] == 1'b1) begin // Negative
                dem_drive_out <= 6'd0;
                error_z1 <= noise_shaped_audio; // Everything is error since output is 0
            end 
            else begin
                // Normal Operation: Extract the top bits for the physical resistors
                dem_drive_out <= noise_shaped_audio[FRAC_WIDTH+5 : FRAC_WIDTH];
                
                // Extract the discarded fractional bits as the new error
                // Sign-extend the fraction to keep math safe
                error_z1 <= $signed({1'b0, noise_shaped_audio[FRAC_WIDTH-1 : 0]});
            end
            
            // B. Shift the delay line
            error_z2 <= error_z1;
        end
    end

endmodule